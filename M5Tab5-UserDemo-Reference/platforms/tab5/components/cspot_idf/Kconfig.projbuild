## M5Tab5-UserDemo-Reference/platforms/tab5/components/cspot_idf/Kconfig.projbuild
```kconfig
menu "CSpot (Spotify Connect)"

    config CSPOT_DEVICE_NAME
        string "Device name visible in Spotify"
        default "M5Tab5"
        help
            Name shown to Spotify clients when choosing a speaker.

endmenu
```

## M5Tab5-UserDemo-Reference/platforms/tab5/sdkconfig.defaults
```kconfig
CONFIG_IDF_TARGET="esp32p4"
CONFIG_ESPTOOLPY_FLASHMODE_QIO=y
CONFIG_ESPTOOLPY_FLASHSIZE_16MB=y
CONFIG_PARTITION_TABLE_CUSTOM=y
CONFIG_COMPILER_OPTIMIZATION_PERF=y
CONFIG_SPIRAM=y
CONFIG_SPIRAM_SPEED_200M=y
CONFIG_SPIRAM_XIP_FROM_PSRAM=y
CONFIG_CACHE_L2_CACHE_256KB=y
CONFIG_CACHE_L2_CACHE_LINE_128B=y
CONFIG_FREERTOS_HZ=1000
CONFIG_FREERTOS_VTASKLIST_INCLUDE_COREID=y
CONFIG_FREERTOS_GENERATE_RUN_TIME_STATS=y
CONFIG_ESP_BROOKESIA_MEMORY_USE_CUSTOM=y
CONFIG_LV_COLOR_SCREEN_TRANSP=y
CONFIG_LV_MEM_CUSTOM=y
CONFIG_LV_MEMCPY_MEMSET_STD=y
CONFIG_LV_DISP_DEF_REFR_PERIOD=25
CONFIG_LV_USE_LOG=y
CONFIG_LV_LOG_PRINTF=y
CONFIG_LV_USE_PERF_MONITOR=y
CONFIG_LV_ATTRIBUTE_FAST_MEM_USE_IRAM=y
CONFIG_LV_FONT_MONTSERRAT_8=y
CONFIG_LV_FONT_MONTSERRAT_10=y
CONFIG_LV_FONT_MONTSERRAT_12=y
CONFIG_LV_FONT_MONTSERRAT_16=y
CONFIG_LV_FONT_MONTSERRAT_18=y
CONFIG_LV_FONT_MONTSERRAT_20=y
CONFIG_LV_FONT_MONTSERRAT_22=y
CONFIG_LV_FONT_MONTSERRAT_24=y
CONFIG_LV_FONT_MONTSERRAT_26=y
CONFIG_LV_FONT_MONTSERRAT_28=y
CONFIG_LV_FONT_MONTSERRAT_30=y
CONFIG_LV_FONT_MONTSERRAT_32=y
CONFIG_LV_FONT_MONTSERRAT_34=y
CONFIG_LV_FONT_MONTSERRAT_36=y
CONFIG_LV_FONT_MONTSERRAT_38=y
CONFIG_LV_FONT_MONTSERRAT_40=y
CONFIG_LV_FONT_MONTSERRAT_42=y
CONFIG_LV_FONT_MONTSERRAT_44=y
CONFIG_LV_FONT_FMT_TXT_LARGE=y
CONFIG_LV_USE_FONT_COMPRESSED=y
CONFIG_LV_USE_DEMO_BENCHMARK=y
CONFIG_IDF_EXPERIMENTAL_FEATURES=y

# Tab5 WiFi via ESP-Hosted SDIO to ESP32-C6 coprocessor
CONFIG_SLAVE_IDF_TARGET_ESP32C6=y
CONFIG_ESP_HOSTED_SDIO_HOST_INTERFACE=y
# CONFIG_ESP_HOSTED_SPI_HOST_INTERFACE is not set
CONFIG_ESP_HOSTED_SDIO_RESET_ACTIVE_LOW=y
CONFIG_ESP_HOSTED_SDIO_OPTIMIZATION_RX_STREAMING_MODE=y
CONFIG_ESP_HOSTED_SDIO_GPIO_RESET_SLAVE=15
CONFIG_ESP_HOSTED_SDIO_4_BIT_BUS=y
CONFIG_ESP_HOSTED_SDIO_BUS_WIDTH=4
CONFIG_ESP_HOSTED_SDIO_CLOCK_FREQ_KHZ=40000
# Tab5's actual SDIO pins (from verified hardware — see CLAUDE.md).
# ESP-Hosted defaults (18/19/14/15/16/17) collide with reset GPIO 15 on Tab5.
CONFIG_ESP_HOSTED_SDIO_PIN_CLK=12
CONFIG_ESP_HOSTED_SDIO_PIN_CMD=13
CONFIG_ESP_HOSTED_SDIO_PIN_D0=11
# D1 is derived from _PRIV_PIN_D1_4BIT_BUS (default 15 — same as reset! broken).
# Override the PRIV config; PIN_D1 auto-derives from this.
CONFIG_ESP_HOSTED_SDIO_PRIV_PIN_D1_4BIT_BUS=10
CONFIG_ESP_HOSTED_SDIO_PIN_D1=10
CONFIG_ESP_HOSTED_SDIO_PIN_D2=9
CONFIG_ESP_HOSTED_SDIO_PIN_D3=8

# Allow old I2C cmd API (bell's ESP sinks) to coexist with new driver_ng (BSP)
CONFIG_I2C_SKIP_LEGACY_CONFLICT_CHECK=y
# Allow task stacks in PSRAM (needed after cspot's BSS grows internal heap pressure)
CONFIG_FREERTOS_TASK_CREATE_ALLOW_EXT_MEM=y

# cspot memory strategy (squeezelite approach)
# Hardware AES disabled: with HW-AES enabled, mbedtls_aes_crypt_ctr hangs when
# given SRAM scratch buffers (likely DMA init issue on P4 Rev 1.3). Software
# AES is slower but works from any heap region including the PSRAM track
# prefetch buffers.
# CONFIG_MBEDTLS_HARDWARE_AES=n
# Allow mbedTLS to use PSRAM for large TLS record buffers
CONFIG_MBEDTLS_EXTERNAL_MEM_ALLOC=y
# TLS record buffer: must fit full CDN range-GET records (up to 16 KB standard
# TLS record size). Smaller values cause mbedtls_ssl_fetch_input to return
# BAD_INPUT_DATA (-0x7100) mid-stream when the server delivers a max-size record.
CONFIG_MBEDTLS_SSL_IN_CONTENT_LEN=16384
CONFIG_MBEDTLS_SSL_OUT_CONTENT_LEN=4096
# Enable C++ exceptions (required by cspot)
CONFIG_COMPILER_CXX_EXCEPTIONS=y
CONFIG_CODEC_I2C_BACKWARD_COMPATIBLE=n

# cspot opens a FRESH HTTPS connection per CDN range-request (~7 per 1.6 MB
# track). Default CONFIG_LWIP_MAX_SOCKETS=10 leaks TIME_WAIT slots on P4;
# net_connect returns -66 (SOCKET_FAILED) after the first few tracks, every
# subsequent .read() returns 0 bytes → Vorbis decodes silence. Bump the pool.
CONFIG_LWIP_MAX_SOCKETS=16

# ESP32-P4 / cspot CDN streaming: default CONFIG_LWIP_TCP_WND_DEFAULT=5760
# (5.7 KB) is too small for Spotify CDN at 256 KB Range bodies — the server
# fills the window, waits for ACK, and TLS read layers above return
# WANT_READ before full records arrive. Bump to 64 KB. Also enable SO_RCVBUF
# so apps can tune receive buffers.
CONFIG_LWIP_TCP_WND_DEFAULT=16384
CONFIG_LWIP_TCP_SND_BUF_DEFAULT=16384
CONFIG_LWIP_SO_RCVBUF=y

# Move WiFi + lwIP pbuf allocations to PSRAM — prevents SDIO DMA-capable
# internal SRAM exhaustion during sustained CDN streaming (assert failed:
# sdio_rx_get_buffer sdio_drv.c:670 crash after ~200 s of playback).
CONFIG_SPIRAM_TRY_ALLOCATE_WIFI_LWIP=y

# Disable SDIO RX streaming mode — it queues too many DMA-capable SRAM buffers.
# RX_NONE gives the same throughput on ESP32-P4 without the memory blowup.
CONFIG_ESP_HOSTED_SDIO_OPTIMIZATION_RX_NONE=y
CONFIG_ESP_HOSTED_SDIO_RX_Q_SIZE=8
```
